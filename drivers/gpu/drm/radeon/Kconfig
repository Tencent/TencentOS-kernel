## drivers/gpu/drm/radeon/Kconfig
```kconfig
# SPDX-License-Identifier: GPL-2.0-only
config DRM_RADEON_USERPTR
	bool "Always enable userptr support"
	depends on DRM_RADEON
	select MMU_NOTIFIER
	help
	  This option selects CONFIG_MMU_NOTIFIER if it isn't already
	  selected to enabled full userptr support.

config ARCH_PHYTIUM_1500A_MEM_TYPE_DEVICE
	tristate "1500a set radeon mem type is device and nocache"
```

## drivers/ssd/Kconfig
```kconfig
menu "SSD device support"

config SSD_DRV
	tristate "SSD device support"
	---help---
	  SSD driver

endmenu
```

## fs/cgroupfs/Kconfig
```kconfig
# SPDX-License-Identifier: GPL-2.0-only
config CGROUPFS
	bool "cgroupfs file system support"
	default n
	help
	The cgroupfs is used to present independent resource views inside container,
	include cpuinfo, meminfo, stat and so on.
```

## kernel/tkernel/kpatch/Kconfig
```kconfig
# SPDX-License-Identifier: GPL-2.0-only
config KPATCH
	tristate "Kernel Kpatching"
	depends on DYNAMIC_FTRACE_WITH_REGS
	depends on MODULES
	depends on SYSFS
	help
	  Say M here if you want to support kernel kpatch.
	  This option has no runtime impact until a kernel "patch"
	  module uses the interface provided by this option to register
	  a patch, causing calls to patched functions to be redirected
	  to new function code contained in the patch module.
```

## net/toa/Kconfig
```kconfig
config TOA
       tristate "The private TCP option for support Taobao LVS full-NAT feature"
       default m
       ---help---
         This option saves the original IP address and source port of a TCP segment
         after LVS performed NAT on it. So far, this module only supports IPv4 and
         IPv6 mapped IPv4.

         Say m if unsure.
```
